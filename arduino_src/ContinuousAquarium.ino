// RTClib - Version: 1.4.0
#include <RTClib.h>

// Custom libraries
#include "SerialPortInitializer.h"
#include "I2CPortInitializer.h"
#include "RealTimeClock.h"
#include "IOManager.h"
#include "AcuariumDebouncer.h"
#include "ManualLightController.h"
#include "AutomaticLightController.h"

// System variables
RTC_DS3231 rtc_ds3231;

// Custom variables
SerialPortInitializer *serialPortInitializer;
I2CPortInitializer *i2CPortInitializer;
RealTimeClock *realTimeClock;
IOManager *iOManager;
InputDebouncer *manualDebouncer;
InputDebouncer *screenOnOffDebouncer;
InputDebouncer *whiteDebouncer;
InputDebouncer *blueDebouncer;
ManualLightController *manualLightController;
AutomaticLightController *automaticLightController;

bool isFlashOn;

void setup() {
  serialPortInitializer = new SerialPortInitializer();
  i2CPortInitializer = new I2CPortInitializer();
  manualDebouncer = new InputDebouncer();
  screenOnOffDebouncer = new InputDebouncer();
  whiteDebouncer = new InputDebouncer();
  blueDebouncer = new InputDebouncer();
  realTimeClock = new RealTimeClock(&rtc_ds3231);
  iOManager = new IOManager(manualDebouncer, screenOnOffDebouncer, whiteDebouncer, blueDebouncer);
  manualLightController = new ManualLightController(iOManager);
  automaticLightController = new AutomaticLightController(&rtc_ds3231);
  
  serialPortInitializer->setupSerialAndWaitForConsoleReady();
  delay(500);

  i2CPortInitializer->setupI2CAndSetSpeed();
  delay(500);

  free(serialPortInitializer);
  free(i2CPortInitializer);

  AcuariumDebouncer::setupDebouncers(manualDebouncer, screenOnOffDebouncer, whiteDebouncer, blueDebouncer);

  if (!realTimeClock->setupRealTimeClock())
  {
    Serial.println("Error setting up the RTC. System stopped.");
    noInterrupts();
    while (1) {};
  }
  
  iOManager->setupInputOutputs();
  delay(500);
  
  iOManager->setupInterrupts();
  delay(500);
}

void loop() {
  if (iOManager->isManualInputOn())
  {
    isFlashOn = !isFlashOn;
    iOManager->setWhiteLevel(manualLightController->calculateCurrentWhiteLevel(), isFlashOn);
    iOManager->setBlueLevel(manualLightController->calculateCurrentBlueLevel(), isFlashOn);
  }
  else
  {
    Serial.println("Auto");
    int white = automaticLightController->calculateCurrentWhiteLevel();
    int blue = automaticLightController->calculateCurrentBlueLevel();
    
    iOManager->setWhiteLevel(white, true);
    iOManager->setBlueLevel(blue, true);
    manualLightController->setLevels(white, blue);
  }
  
  delay(500);
}
